## Kconfig
```kconfig
# Copyright (c) 2026 The AI Companion Contributors
# SPDX-License-Identifier: MIT
#
# Kconfig for the in-repo module (referenced by zephyr/module.yml `kconfig:`).

config ZMK_BEHAVIOR_HAPTIC
    bool "DRV2605L haptic trigger behavior"
    default y
    depends on DT_HAS_AIC_BEHAVIOR_HAPTIC_ENABLED
    select I2C
    help
      Custom ZMK behavior that fires a DRV2605L one-shot haptic effect over raw
      I2C. Auto-enabled when an `aic,behavior-haptic` devicetree node is present.

DT_CHOSEN_AIC_COMM_UART := aic,comm-uart

config AIC_COMM
    bool "AI Companion host communication (USB CDC-ACM JSON channel)"
    default y if $(dt_chosen_enabled,$(DT_CHOSEN_AIC_COMM_UART))
    help
      Host <-> device communication over a USB CDC-ACM virtual serial port,
      exchanging newline-delimited JSON (see docs/phase5-interface-contract.md).
      The host pushes `screen`/`haptic`/`tasks`/`ping`; the device replies with
      `input`/`hello`/`pong` and drives the LVGL status screen + DRV2605L haptic.
      Auto-enabled when the `aic,comm-uart` chosen node is present. The required
      USB CDC / SERIAL / UART symbols are turned on in the shield .conf.

config ZMK_BEHAVIOR_AIC_INPUT
    bool "AI Companion physical-button input behavior"
    default y
    depends on DT_HAS_AIC_BEHAVIOR_INPUT_ENABLED && AIC_COMM
    help
      Custom ZMK behavior bound to the 4 buttons (Voice/Yes/No/Open). On press it
      reports the button + current screen state/id to the host as an `input`
      message over the CDC channel (src/behavior_input.c -> aic_comm_send_input).
      Requires AIC_COMM. Auto-enabled when an `aic,behavior-input` node is
      present (the ai_companion keymap defines one).
```

## boards/shields/ai_companion/Kconfig.shield
```kconfig
# Copyright (c) 2026 The AI Companion Contributors
# SPDX-License-Identifier: MIT
config SHIELD_AI_COMPANION
    def_bool $(shields_list_contains,ai_companion)
```

## boards/shields/ai_companion_color/Kconfig.defconfig
```kconfig
# Copyright (c) 2026 The AI Companion Contributors
# SPDX-License-Identifier: MIT

if SHIELD_AI_COMPANION_COLOR

config ZMK_KEYBOARD_NAME
    default "AI Companion C"

endif
```

## boards/shields/ai_companion_color/Kconfig.shield
```kconfig
# Copyright (c) 2026 The AI Companion Contributors
# SPDX-License-Identifier: MIT
config SHIELD_AI_COMPANION_COLOR
    def_bool $(shields_list_contains,ai_companion_color)
```

## dts/bindings/behaviors/aic,behavior-haptic.yaml
```yaml
# Copyright (c) 2026 The AI Companion Contributors
# SPDX-License-Identifier: MIT

description: |
  DRV2605L haptic trigger behavior. The node is BOTH a ZMK behavior (referenced
  from the keymap by phandle, zero binding cells) AND the DRV2605L I2C device
  (address 0x5a on the XIAO I2C bus), so the behavior can drive it over raw I2C.

compatible: "aic,behavior-haptic"

include: [zero_param.yaml, i2c-device.yaml]
```

## dts/bindings/behaviors/aic,behavior-input.yaml
```yaml
# Copyright (c) 2026 The AI Companion Contributors
# SPDX-License-Identifier: MIT

description: |
  AI Companion physical-button behavior. Bound to the 4 buttons in the keymap
  as `&aic_input <KEY>`, where the single parameter is the button id
  (VOICE/YES/NO/OPEN). On press it sends an `input` message to the host over
  the USB CDC-ACM channel naming the button plus the current screen state/id;
  the host decides what the press means for the screen shown at that moment.

compatible: "aic,behavior-input"

include: one_param.yaml
```

## dts/bindings/behaviors/aic,behavior-voice-screen.yaml
```yaml
# Copyright (c) 2026 The AI Companion Contributors
# SPDX-License-Identifier: MIT

description: |
  AI Companion local Voice "listening" screen behavior. Referenced from the
  keymap by phandle (zero binding cells), wrapped in the voice_ptt macro's
  macro_press/macro_release so its press shows the device's own LISTENING
  screen and its release restores the previous screen — tracking the physical
  Voice hold, independent of any host.

compatible: "aic,behavior-voice-screen"

include: zero_param.yaml
```
